## iot-http/Config.in
```kconfig
#
# Copyright (C) 2010-2024 OpenWrt.org
#
# This is free software, licensed under the GNU General Public License v2.
# See /LICENSE for more information.
#

if PACKAGE_iot-http
comment "Build Options"

config ONE_DEVICE_LOGIN_LIMIT
	bool "Enable only one device login at the same time, the latest device will login failed"
	default n
	help
		only one device logged in at the same time, the latest device will login failed


config ONE_DEVICE_LOGIN_LIMIT_WITH_REPLACING
	bool "Enable replacing the last one, the latest device will login successful"
	depends on ONE_DEVICE_LOGIN_LIMIT
	default n
	help
		replacing the last one, the latest device will login successful

endif
```

## iot-rpc/Config.in
```kconfig
#
# Copyright (C) 2010-2024 OpenWrt.org
#
# This is free software, licensed under the GNU General Public License v2.
# See /LICENSE for more information.
#

if PACKAGE_iot-rpc
comment "Build Options"

config IOT_RPC_LUA_SCRIPT_OBFUSCATED
	bool "Enable iot rpc lua scripts obfuscated"
	default n
	help
		iot rpc lua scripts obfuscated

endif
```
